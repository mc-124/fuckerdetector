## main/Kconfig.projbuild
```kconfig
menu "FuckerDetector config"

    choice APP_FIRMWARE_TYPE
        prompt "编译固件类型"
        default APP_SERVER
            
        config APP_SERVER
            bool "Server - 服务端（探测器）"
                
        config APP_CLIENT
            bool "Client - 客户端（接收器）"
    
    endchoice

    menu "杂项"

        config APP_BLE_COMPANY_ID
            hex "广告的 ManfacturerData 中 CompanyID 字段的值"
            range 0x0000 0xffff
            default 0xff64

        config APP_BLE_PROTOCOL_VER
            hex "广告中数据包的协议版本号（仅用于避免冲突）"
            range 0x0000 0xffff
            default 0xCC55
    
    endmenu

    menu "Client - 客户端（接收器）配置 "

        # functions

        config APP_CLIENT_RX_SERVERALARM
            bool "允许接收服务端警报"
            default y

        config APP_CLIENT_TX_CLIENTALARM
            bool "允许发送客户端警报"
            default y

        config APP_CLIENT_TX_LOUDALARM
            bool "允许发送客户端强力警报"
            default y
        
        config APP_CLIENT_RX_CLIENTALARM
            bool "允许接收客户端警报"
            default y 

        config APP_CLIENT_RX_LOUDALARM
            bool "允许接收客户端强力警报"
            default y 

        config APP_CLIENT_TX_CLIENTRESP
            bool "允许发送客户端响应"
            default y
            depends on APP_CLIENT_RX_CLIENTALARM

        config APP_CLIENT_RX_CLIENTRESP
            bool "允许接收客户端响应"
            default y 
            depends on APP_CLIENT_TX_CLIENTALARM || APP_CLIENT_TX_LOUDALARM

        # ble

        config APP_CLIENT_BLE_NAME
            string "广告包设备名称（长度小于 16 字节）"
            default "cliV2"

        config APP_CLIENT_ADV_ITVL_MAX
            int "最大广告间隔 (ms)"
            range 20 10240
            default 128
            depends on APP_CLIENT_TX_CLIENTALARM || APP_CLIENT_TX_LOUDALARM
        
        config APP_CLIENT_ADV_ITVL_MIN
            int "最小广告间隔 (ms)"
            range 20 10240
            default 32
            depends on APP_CLIENT_TX_CLIENTALARM || APP_CLIENT_TX_LOUDALARM

        config APP_CLIENT_SCAN_ITVL
            int "扫描间隔 (ms)"
            range 20 10240
            default 96
            depends on APP_CLIENT_RX_SERVERALARM || APP_CLIENT_RX_CLIENTALARM || APP_CLIENT_RX_LOUDALARM

        config APP_CLIENT_SCAN_WINDOW
            int "扫描窗口 (ms)"
            range 20 10240
            default 48
            depends on APP_CLIENT_RX_SERVERALARM || APP_CLIENT_RX_CLIENTALARM || APP_CLIENT_RX_LOUDALARM

        # times

        config APP_CLIENT_TRANSMIT_ALARM_DURATION
            int "发送警告广告包持续时间 (ms)"
            range 500 10000
            default 1500
            depends on APP_CLIENT_TX_CLIENTALARM || APP_CLIENT_TX_LOUDALARM
        
        config APP_CLIENT_TRANSMIT_ALARM_INTERVAL
            int "发送警告广告包后的冷却期 (ms)"
            range 1 10000
            default 1000
            depends on APP_CLIENT_TX_CLIENTALARM || APP_CLIENT_TX_LOUDALARM

        config APP_CLIENT_TRANSMIT_RESP_DURATION
            int "发送响应广告包持续时间 (ms)"
            range 500 10000
            default 1500
            depends on APP_CLIENT_TX_CLIENTRESP || APP_CLIENT_TX_LOUDALARM

        config APP_CLIENT_SCAN_RESP_DURATION
            int "扫描响应广告包持续时间 (ms)"
            range 500 10000
            default 1500
            depends on APP_CLIENT_RX_CLIENTRESP

        config APP_CLIENT_IDLE_UPDATE_UI_INTERVAL
            int "空闲时更新 UI 间隔 (ms)"
            range 500 100000000
            default 60000

        # other

        config APP_CLIENT_VIBRATION_PWM_FREQ
            int "震动 PWM 频率 (Hz)"
            range 0 16383
            default 200

        config APP_CLIENT_MAINLOOP_TPS
            int "主循环 TPS （设置 0 则无等待）"
            default 20
            range 1 1000

    endmenu

    menu "Server - 服务端（探测器）配置"

        config APP_SERVER_BLE_NAME
            string "广告包名称（长度小于 16 字节）"
            default "srvV2"

        choice APP_SERVER_RTC_TYPE
            prompt "RTC 模块类型"
            default APP_SERVER_RTC_DS3231

            config APP_SERVER_RTC_DISABLED
                bool "禁用（不稳定）"

            config APP_SERVER_RTC_DS3231
                bool "DS3231"
        endchoice

        config APP_SERVER_ADV_DURATION
            int "广告持续时间 (ms)"
            range 500 60000
            default 5000

        config APP_SERVER_ADV_ITVL_MAX
            int "最大广告间隔 (ms)"
            range 20 10240
            default 128

        config APP_SERVER_ADV_ITVL_MIN
            int "最小广告间隔 (ms)"
            range 20 10240
            default 32

        config APP_SERVER_SLPITVL_MAX_NUM
            int "最大睡眠间隔数量"
            range 2 255
            default 16

        choice APP_SERVER_RADER_TYPE
            prompt "雷达类型"
            default APP_SERVER_RADER_HLKLD1040

            config APP_SERVER_RADER_UNKNOWN
                bool "未知（不稳定）"

            config APP_SERVER_RADER_HLKLD1040
                bool "HLK-LD1040 / HLK-LD1040C"

        endchoice

        choice APP_SERVER_RADER_TRIG_TYPE
            prompt "雷达触发电平"
            default APP_SERVER_RADER_TRIG_HIGH
            depends on APP_SERVER_RADER_UNKNOWN

            config APP_SERVER_RADER_TRIG_HIGH
                bool "高电平触发"

            config APP_SERVER_RADER_TRIG_LOW
                bool "低电平触发"
        endchoice

        config APP_SERVER_RADER_PWRON_DURATION
            int "雷达上电初始化持续时间 (ms)"
            range 0 60000
            default 7000
            depends on APP_SERVER_RADER_UNKNOWN

        config APP_SERVER_AUTOPWOFF_ENABLED
            bool "启用低电压自动关机"
            default y
        
        config APP_SERVER_AUTOPWOFF_LIMIT
            int "关机电压 (mV)"
            range 2000 4000
            default 2700
            depends on APP_SERVER_AUTOPWOFF_ENABLED
    endmenu

endmenu
```
